## drivers/Kconfig
```kconfig
comment "Device Drivers"

rsource "display/Kconfig"
rsource "battery/Kconfig"
rsource "ms8607/Kconfig"
rsource "veml6030/Kconfig"
rsource 'semseaor_s8/Kconfig"
```

## drivers/display/Kconfig
```kconfig
# UC8151 display controller configuration options

# Copyright (c) 2020 Phytec Messtechnik GmbH
# SPDX-License-Identifier: Apache-2.0

config UC8151
	bool "UC8151 compatible display controller driver"
	depends on SPI
	depends on HEAP_MEM_POOL_SIZE != 0
	help
	  Enable driver for UC8151 compatible controller.
```

## subsys/Kconfig
```kconfig
comment "Subsystems"

rsource "bme280/Kconfig"
rsource "max44009/Kconfig"
rsource "battery/Kconfig"
rsource "senseair_s8/Kconfig"
```

## subsys/battery/Kconfig
```kconfig
menuconfig SUBSYS_BATTERY
    bool "BATTERY sensor sampling subsystem"
    depends on ADC
    help
      Enable battery measurement thread that continuously samples battery ADC values.

config SUBSYS_BATTERY_STACK_SIZE
    int "BATTERY thread stack size"
    depends on SUBSYS_BATTERY
    default 512
    help
      Size of BATTERY thread stack

config SUBSYS_BATTERY_THREAD_PRIORITY
    int "BATTERY thread priority"
    depends on SUBSYS_BATTERY
    default -3
    help
      Priority of the BATTERY thread. Should be negative,
      as sensor reads might fail if preempted.

config SUBSYS_BATTERY_SAMPLING_RATE_MS
    int "BATTERY sampling rate (ms)"
    depends on SUBSYS_BATTERY
    default 200000
    range 2000 1000000000
    help
      The sampling rate of the sensor in milliseconds.

config SUBSYS_BATTERY_MAX_FETCH_ATTEMPTS
    int "BATTERY number of attempts to fetch new sample"
    depends on SUBSYS_BATTERY
    default 5
    range 1 20
    help
      Maximum number of times a sample is requested until an error is raised

config SUBSYS_BATTERY_CALLBACK_MAX_COUNT
    int "BATTERY max callbacks"
    depends on SUBSYS_BATTERY
    default 10
    help
      Maximum number of battery callbacks
```

## subsys/bme280/Kconfig
```kconfig
menuconfig SUBSYS_BME280
    bool "BME280 sensor sampling subsystem"
    depends on BME280
    help
      Enable BME280 thread that continuously samples BME280 values.

config SUBSYS_BME280_STACK_SIZE
    int "BME280 thread stack size"
    depends on SUBSYS_BME280
    default 512
    help
      Size of BME280 thread stack

config SUBSYS_BME280_THREAD_PRIORITY
    int "BME280 thread priority"
    depends on SUBSYS_BME280
    default -3
    help
      Priority of the BME280 thread. Should be negative,
      as sensor reads might fail if preempted.

config SUBSYS_BME280_SAMPLING_RATE_MS
    int "BME280 sampling rate (ms)"
    depends on SUBSYS_BME280
    default 2000
    range 2000 1000000000
    help
      The sampling rate of the sensor in milliseconds. Needs to be at least
      2000, as the sensor cannot sample faster.

config SUBSYS_BME280_MAX_FETCH_ATTEMPTS
    int "BME280 number of attempts to fetch new sample"
    depends on SUBSYS_BME280
    default 5
    range 1 20
    help
      Maximum number of times a sample is requested until an error is raised

config SUBSYS_BME280_CALLBACK_MAX_COUNT_TEMPERATURE
    int "BME280 max callbacks for temperature"
    depends on SUBSYS_BME280
    default 10
    help
      Maximum number of temperature callbacks registered to the BME280 device

config SUBSYS_BME280_CALLBACK_MAX_COUNT_HUMIDITY
    int "BME280 max callbacks for humidity"
    depends on SUBSYS_BME280
    default 10
    help
      Maximum number of humidity callbacks registered to the BME280 device

config SUBSYS_BME280_CALLBACK_MAX_COUNT_PRESSURE
    int "BME280 max callbacks for pressure"
    depends on SUBSYS_BME280
    default 10
    help
      Maximum number of pressure callbacks registered to the BME280 device
```

## subsys/max44009/Kconfig
```kconfig
menuconfig SUBSYS_MAX44009
    bool "MAX44009 sensor sampling subsystem"
    depends on MAX44009
    help
      Enable MAX44009 thread that continuously samples MAX44009 values.

config SUBSYS_MAX44009_STACK_SIZE
    int "MAX44009 thread stack size"
    depends on SUBSYS_MAX44009
    default 512
    help
      Size of MAX44009 thread stack

config SUBSYS_MAX44009_THREAD_PRIORITY
    int "MAX44009 thread priority"
    depends on SUBSYS_MAX44009
    default -3
    help
      Priority of the MAX44009 thread. Should be negative,
      as sensor reads might fail if preempted.

config SUBSYS_MAX44009_SAMPLING_RATE_MS
    int "MAX44009 sampling rate (ms)"
    depends on SUBSYS_MAX44009
    default 2000
    range 2000 1000000000
    help
      The sampling rate of the sensor in milliseconds. Needs to be at least
      2000, as the sensor cannot sample faster.

config SUBSYS_MAX44009_MAX_FETCH_ATTEMPTS
    int "MAX44009 number of attempts to fetch new sample"
    depends on SUBSYS_MAX44009
    default 5
    range 1 20
    help
      Maximum number of times a sample is requested until an error is raised

config SUBSYS_MAX44009_CALLBACK_MAX_COUNT_AMBIENT_LIGHT
    int "MAX44009 max callbacks for ambient light"
    depends on SUBSYS_MAX44009
    default 10
    help
      Maximum number of ambien light callbacks registered to the MAX44009 device
      
```
